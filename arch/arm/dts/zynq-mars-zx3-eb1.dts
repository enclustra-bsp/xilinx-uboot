/*
 * Enclustra Mars ZX3 SOM on EB1 devicetree
 *
 * Copyright (C) 2015 Antmicro Ltd
 *
 * SPDX-License-Identifier:	GPL-2.0+
 */
/dts-v1/;
#include "zynq-7000.dtsi"

/ {
	model = "Enclustra Mars ZX3 SOM on EB1";
	compatible = "xlnx,zynq-7000";

	aliases {
		serial0 = &uart0;
	};

	memory {
		device_type = "memory";
		reg = <0 0x20000000>;
	};
};
