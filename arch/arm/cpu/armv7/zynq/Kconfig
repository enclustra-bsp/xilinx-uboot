## arch/arm/cpu/armv7/zynq/Kconfig
```kconfig
if ZYNQ

choice
	prompt "Xilinx Zynq board select"

config TARGET_ZYNQ_ZED
	bool "Zynq ZedBoard"

config TARGET_ZYNQ_MICROZED
	bool "Zynq MicroZed"

config TARGET_ZYNQ_ZC70X
	bool "Zynq ZC702/ZC706 Board"

config TARGET_ZYNQ_ZC770
	bool "Zynq ZC770 Board"

config TARGET_ZYNQ_ZYBO
	bool "Zynq Zybo Board"

config TARGET_ZYNQ_AFX
	bool "Zynq AFX Board"

config TARGET_ZYNQ_CSE
	bool "Zynq CSE Board"

config TARGET_ZYNQ_MARS_ZX3
	bool "Enclustra Mars ZX3 SOM"

config TARGET_ZYNQ_MARS_ZX3_STA
	bool "Enclustra Mars ZX3 SOM on Mars Starter Baseboard"

config TARGET_ZYNQ_MARS_ZX2
	bool "Enclustra Mars ZX2 SOM"

config TARGET_ZYNQ_MERCURY
	bool "Enclustra Mercury family SOM's"

endchoice

config SYS_BOARD
	default "zynq"

config SYS_VENDOR
	default "xilinx"

config SYS_SOC
	default "zynq"

config SYS_CONFIG_NAME
	default "zynq_zed" if TARGET_ZYNQ_ZED
	default "zynq_microzed" if TARGET_ZYNQ_MICROZED
	default "zynq_zc70x" if TARGET_ZYNQ_ZC70X
	default "zynq_zc770" if TARGET_ZYNQ_ZC770
	default "zynq_zybo" if TARGET_ZYNQ_ZYBO
	default "zynq_cse" if TARGET_ZYNQ_CSE
	default "zynq_afx" if TARGET_ZYNQ_AFX
	default "zynq_mars_zx3" if TARGET_ZYNQ_MARS_ZX3
	default "zynq_mars_zx3_sta" if TARGET_ZYNQ_MARS_ZX3_STA
	default "zynq_mars_zx2" if TARGET_ZYNQ_MARS_ZX2
	default "zynq_mercury" if TARGET_ZYNQ_MERCURY

endif
```

## configs/enclustra_zynqmp_mars_xu3_defconfig
```kconfig
CONFIG_SYS_CONFIG_NAME="enclustra_xu"
CONFIG_IDENT_STRING=" Enclustra Mars XU3"
CONFIG_SYS_PROMPT="Mars XU3> "
CONFIG_DEFAULT_DEVICE_TREE="mars-xu3"
CONFIG_ENCLUSTRA_QSPI_FLASHMAP=y
CONFIG_ATSHA204A=y
CONFIG_ENCLUSTRA_EEPROM_MAC=y
CONFIG_SF_DEFAULT_SPEED=50000000
# CONFIG_OF_LIST is not set
# CONFIG_SPL is not set
```

## configs/enclustra_zynqmp_mercury_xu1_defconfig
```kconfig
CONFIG_ARM=y
CONFIG_SYS_CONFIG_NAME="enclustra_xu"
CONFIG_ARCH_ZYNQMP=y
CONFIG_SYS_TEXT_BASE=0x8000000
CONFIG_SYS_MALLOC_F_LEN=0x8000
CONFIG_IDENT_STRING=" Enclustra Mercury XU1"
CONFIG_ZYNQMP_QSPI=y
CONFIG_ZYNQMP_USB=y
CONFIG_SPI_GENERIC=y
CONFIG_DEFAULT_DEVICE_TREE="mercury-xu1"
CONFIG_DEBUG_UART=y
CONFIG_AHCI=y
CONFIG_FIT=y
CONFIG_FIT_VERBOSE=y
CONFIG_USE_BOOTCOMMAND=y
CONFIG_BOOTCOMMAND="run $modeboot"
# CONFIG_DISPLAY_CPUINFO is not set
# CONFIG_DISPLAY_BOARDINFO is not set
CONFIG_HUSH_PARSER=y
CONFIG_SYS_PROMPT="Mercury XU1> "
CONFIG_CMD_MEMTEST=y
# CONFIG_CMD_FLASH is not set
CONFIG_CMD_GPIO=y
CONFIG_CMD_I2C=y
CONFIG_CMD_MMC=y
CONFIG_CMD_SF=y
CONFIG_CMD_USB=y
CONFIG_CMD_TFTPPUT=y
CONFIG_CMD_DHCP=y
CONFIG_CMD_MII=y
CONFIG_CMD_PING=y
CONFIG_CMD_TIME=y
CONFIG_CMD_TIMER=y
CONFIG_CMD_EXT2=y
CONFIG_CMD_EXT4=y
CONFIG_CMD_EXT4_WRITE=y
CONFIG_CMD_FAT=y
CONFIG_CMD_FS_GENERIC=y
CONFIG_OF_EMBED=y
CONFIG_NET_RANDOM_ETHADDR=y
CONFIG_SPL_DM_SEQ_ALIAS=y
CONFIG_SATA=y
CONFIG_SCSI_AHCI=y
CONFIG_FPGA_XILINX=y
CONFIG_FPGA_ZYNQMPPL=y
CONFIG_DM_GPIO=y
CONFIG_DM_I2C=y
CONFIG_SYS_I2C_CADENCE=y
CONFIG_MISC=y
CONFIG_ATSHA204A=y
CONFIG_ENCLUSTRA_EEPROM_MAC=y
CONFIG_I2C_EEPROM=y
CONFIG_DM_MMC=y
CONFIG_MMC_SDHCI=y
CONFIG_MMC_SDHCI_ZYNQ=y
CONFIG_DM_SPI_FLASH=y
CONFIG_SPI_FLASH=y
CONFIG_SPI_FLASH_BAR=y
CONFIG_SF_DUAL_FLASH=y
CONFIG_SPI_FLASH_SPANSION=y
CONFIG_SPI_FLASH_STMICRO=y
CONFIG_SPI_FLASH_WINBOND=y
CONFIG_DM_ETH=y
CONFIG_ZYNQ_GEM=y
CONFIG_DM_SCSI=y
CONFIG_SPL_DM_SERIAL=y
CONFIG_DEBUG_UART_ZYNQ=y
CONFIG_DEBUG_UART_BASE=0xff000000
CONFIG_DEBUG_UART_CLOCK=100000000
CONFIG_DEBUG_UART_ANNOUNCE=y
CONFIG_ZYNQ_SERIAL=y
CONFIG_ENCLUSTRA_QSPI_FLASHMAP=y
CONFIG_USB=y
CONFIG_USB_XHCI_HCD=y
CONFIG_USB_XHCI_DWC3=y
CONFIG_USB_XHCI_ZYNQMP=y
CONFIG_USB_DWC3=y
CONFIG_USB_DWC3_GADGET=y
CONFIG_USB_DWC3_GENERIC=y
CONFIG_USB_ULPI_VIEWPORT=y
CONFIG_USB_ULPI=y
CONFIG_USB_STORAGE=y
CONFIG_USB_GADGET=y
CONFIG_USB_GADGET_MANUFACTURER="Xilinx"
CONFIG_USB_GADGET_VENDOR_NUM=0x03fd
CONFIG_USB_GADGET_PRODUCT_NUM=0x0300
CONFIG_USB_GADGET_DOWNLOAD=y
CONFIG_SPL_OF_LIBFDT=y
CONFIG_EFI_LOADER_BOUNCE_BUFFER=y
```

## configs/enclustra_zynqmp_mercury_xu8_defconfig
```kconfig
CONFIG_SYS_CONFIG_NAME="enclustra_xu"
CONFIG_IDENT_STRING=" Enclustra Mercury XU8"
CONFIG_SYS_PROMPT="Mercury XU8> "
CONFIG_DEFAULT_DEVICE_TREE="mercury-xu8"
CONFIG_ENCLUSTRA_QSPI_FLASHMAP=y
CONFIG_ATSHA204A=y
CONFIG_ENCLUSTRA_EEPROM_MAC=y
CONFIG_SF_DEFAULT_SPEED=50000000
# CONFIG_OF_LIST is not set
# CONFIG_SPL is not set
```

## configs/enclustra_zynqmp_mercury_xu9_defconfig
```kconfig
CONFIG_SYS_CONFIG_NAME="enclustra_xu"
CONFIG_IDENT_STRING=" Enclustra Mercury XU9"
CONFIG_SYS_PROMPT="Mercury XU9> "
CONFIG_DEFAULT_DEVICE_TREE="enclustra_generated"
CONFIG_ENCLUSTRA_QSPI_FLASHMAP=y
CONFIG_ATSHA204A=y
CONFIG_ENCLUSTRA_EEPROM_MAC=y
CONFIG_SF_DEFAULT_SPEED=50000000
CONFIG_USE_BOOTCOMMAND=y
CONFIG_BOOTCOMMAND="run $modeboot"
# CONFIG_OF_LIST is not set
# CONFIG_SPL is not set
# CONFIG_NET_RANDOM_ETHADDR is not set
```

## configs/zynq_cosmos_defconfig
```kconfig
CONFIG_ARM=y
CONFIG_SYS_CONFIG_NAME="zynq_cosmos"
CONFIG_ARCH_ZYNQ=y
CONFIG_DEFAULT_DEVICE_TREE="zynq-cosmos"
CONFIG_SPL=y
CONFIG_SYS_NO_FLASH=y
CONFIG_HUSH_PARSER=y
CONFIG_SYS_PROMPT="zynq-uboot> "
# CONFIG_CMD_IMLS is not set
# CONFIG_CMD_FLASH is not set
CONFIG_CMD_MMC=y
CONFIG_CMD_SF=y
CONFIG_CMD_SPI=y
CONFIG_CMD_I2C=y
CONFIG_CMD_USB=y
CONFIG_CMD_DFU=y
CONFIG_CMD_GPIO=y
CONFIG_CMD_DHCP=y
CONFIG_CMD_MII=y
CONFIG_CMD_PING=y
CONFIG_CMD_EXT2=y
CONFIG_CMD_EXT4=y
CONFIG_CMD_EXT4_WRITE=y
CONFIG_CMD_FAT=y
CONFIG_CMD_FS_GENERIC=y
CONFIG_OF_EMBED=y
CONFIG_NET_RANDOM_ETHADDR=y
CONFIG_SPL_DM_SEQ_ALIAS=y
CONFIG_ZYNQ_SDHCI=y
CONFIG_SPI_FLASH=y
CONFIG_SPI_FLASH_BAR=y
CONFIG_SPI_FLASH_SPANSION=y
CONFIG_SPI_FLASH_WINBOND=y
CONFIG_ZYNQ_GEM=y
CONFIG_DEBUG_UART=y
CONFIG_DEBUG_UART_ZYNQ=y
CONFIG_DEBUG_UART_BASE=0xe0000000
CONFIG_DEBUG_UART_CLOCK=33333333
CONFIG_ZYNQ_QSPI=y
CONFIG_USB=y
CONFIG_USB_EHCI_HCD=y
CONFIG_USB_ULPI_VIEWPORT=y
CONFIG_USB_ULPI=y
CONFIG_USB_STORAGE=y
CONFIG_USB_GADGET=y
CONFIG_CI_UDC=y
CONFIG_USB_GADGET_DOWNLOAD=y
CONFIG_G_DNL_MANUFACTURER="Xilinx"
CONFIG_G_DNL_VENDOR_NUM=0x03fd
CONFIG_G_DNL_PRODUCT_NUM=0x0300
CONFIG_ENCLUSTRA_EEPROM_MAC=y
```

## configs/zynq_cosmos_xzq10_defconfig
```kconfig
CONFIG_SYS_CONFIG_NAME="zynq_cosmos_xzq10"
CONFIG_IDENT_STRING=" Enclustra Cosmos XZQ10"
CONFIG_SYS_PROMPT="Cosmos XZQ10> "
CONFIG_DEFAULT_DEVICE_TREE="enclustra_generated"
CONFIG_BOARD_COSMOS_XZQ10=y
CONFIG_ATSHA204A=y
CONFIG_ENCLUSTRA_EEPROM_MAC=y
CONFIG_SF_DEFAULT_SPEED=50000000
CONFIG_BOOT_SCRIPT_OFFSET=0x1f80000
CONFIG_USE_BOOTCOMMAND=y
CONFIG_BOOTCOMMAND="run $modeboot"
CONFIG_ENCLUSTRA_QSPI_FLASHMAP=y
# CONFIG_OF_LIST is not set
# CONFIG_SPL is not set
# CONFIG_ENV_IS_IN_SPI_FLASH is not set
# CONFIG_NET_RANDOM_ETHADDR is not set
```

## configs/zynq_mars_zx2_defconfig
```kconfig
CONFIG_SYS_CONFIG_NAME="zynq_mars_zx2"
CONFIG_IDENT_STRING=" Enclustra Mars ZX2"
CONFIG_SYS_PROMPT="Mars ZX2> "
CONFIG_DEFAULT_DEVICE_TREE="enclustra_generated"
CONFIG_ATSHA204A=y
CONFIG_ENCLUSTRA_EEPROM_MAC=y
CONFIG_SF_DEFAULT_SPEED=50000000
CONFIG_BOOT_SCRIPT_OFFSET=0x1f80000
CONFIG_USE_BOOTCOMMAND=y
CONFIG_BOOTCOMMAND="run $modeboot"
CONFIG_ENCLUSTRA_QSPI_FLASHMAP=y
# CONFIG_OF_LIST is not set
# CONFIG_SPL is not set
# CONFIG_ENV_IS_IN_SPI_FLASH is not set
# CONFIG_NET_RANDOM_ETHADDR is not set
```

## configs/zynq_mars_zx3_defconfig
```kconfig
CONFIG_ARM=y
CONFIG_SYS_CONFIG_NAME="zynq_mars_zx3"
CONFIG_ARCH_ZYNQ=y
CONFIG_SYS_TEXT_BASE=0x4000000
# CONFIG_SPL_MMC_SUPPORT is not set
CONFIG_SPL_STACK_R_ADDR=0x200000
CONFIG_DEFAULT_DEVICE_TREE="zynq-mars-zx3"
CONFIG_DEBUG_UART=y
# CONFIG_DISPLAY_CPUINFO is not set
# CONFIG_DISPLAY_BOARDINFO is not set
CONFIG_SPL=y
CONFIG_SPL_STACK_R=y
CONFIG_SPL_OS_BOOT=y
CONFIG_HUSH_PARSER=y
CONFIG_SYS_PROMPT="zynq-uboot> "
CONFIG_CMD_DFU=y
# CONFIG_CMD_FLASH is not set
CONFIG_CMD_GPIO=y
CONFIG_CMD_I2C=y
CONFIG_CMD_MMC=y
CONFIG_CMD_NAND_TRIMFFS=y
CONFIG_CMD_NAND_LOCK_UNLOCK=y
CONFIG_CMD_NAND_TORTURE=y
CONFIG_CMD_MTDPARTS=y
CONFIG_CMD_UBI=y
CONFIG_CMD_SF=y
CONFIG_CMD_SPI=y
CONFIG_CMD_USB=y
CONFIG_CMD_DHCP=y
CONFIG_CMD_MII=y
CONFIG_CMD_PING=y
CONFIG_CMD_EXT2=y
CONFIG_CMD_EXT4=y
CONFIG_CMD_EXT4_WRITE=y
CONFIG_CMD_FAT=y
CONFIG_CMD_FS_GENERIC=y
CONFIG_OF_EMBED=y
CONFIG_NET_RANDOM_ETHADDR=y
CONFIG_SPL_DM_SEQ_ALIAS=y
# CONFIG_SPL_BLK is not set
CONFIG_FPGA_XILINX=y
CONFIG_DM_GPIO=y
CONFIG_DM_I2C=y
CONFIG_SYS_I2C_CADENCE=y
CONFIG_MISC=y
CONFIG_ATSHA204A=y
CONFIG_ENCLUSTRA_EEPROM_MAC=y
CONFIG_I2C_EEPROM=y
CONFIG_MMC_SDHCI=y
CONFIG_MMC_SDHCI_ZYNQ=y
CONFIG_NAND=y
CONFIG_NAND_ZYNQ=y
CONFIG_SPI_FLASH=y
CONFIG_SPI_FLASH_BAR=y
CONFIG_SPI_FLASH_SPANSION=y
CONFIG_SPI_FLASH_WINBOND=y
CONFIG_PHY_MICREL=y
CONFIG_PHY_MICREL_KSZ90X1=y
CONFIG_PHY_MICREL_KSZ8XXX=y
CONFIG_ZYNQ_GEM=y
CONFIG_DEBUG_UART_ZYNQ=y
CONFIG_DEBUG_UART_BASE=0xe0000000
CONFIG_DEBUG_UART_CLOCK=33333333
CONFIG_ZYNQ_SERIAL=y
CONFIG_ZYNQ_QSPI=y
CONFIG_USB=y
CONFIG_USB_EHCI_HCD=y
CONFIG_USB_ULPI_VIEWPORT=y
CONFIG_USB_ULPI=y
CONFIG_USB_STORAGE=y
CONFIG_USB_GADGET=y
CONFIG_CI_UDC=y
CONFIG_USB_GADGET_DOWNLOAD=y
```

## configs/zynq_mars_zx3_eb1_defconfig
```kconfig
CONFIG_SPL=y
CONFIG_ARM=y
CONFIG_ARCH_ZYNQ=y
CONFIG_TARGET_ZYNQ_MARS_ZX3_EB1=y
CONFIG_OF_CONTROL=n
CONFIG_DEFAULT_DEVICE_TREE="zynq-mars-zx3-eb1"
CONFIG_OF_EMBED=y
CONFIG_SPI_FLASH=y
CONFIG_SPI_FLASH_BAR=y
```

## configs/zynq_mars_zx3_sta_defconfig
```kconfig
CONFIG_SPL=y
CONFIG_ARM=y
CONFIG_ARCH_ZYNQ=y
CONFIG_TARGET_ZYNQ_MARS_ZX3_STA=y
CONFIG_OF_CONTROL=n
CONFIG_DEFAULT_DEVICE_TREE="zynq-mars-zx3-sta"
CONFIG_OF_EMBED=y
CONFIG_SPI_FLASH=y
CONFIG_SPI_FLASH_BAR=y
```

## configs/zynq_mercury_defconfig
```kconfig
CONFIG_SYS_CONFIG_NAME="zynq_mercury"
CONFIG_IDENT_STRING=" Enclustra Mercury"
CONFIG_SYS_PROMPT="Mercury> "
CONFIG_DEFAULT_DEVICE_TREE="enclustra_generated"
CONFIG_ATSHA204A=y
CONFIG_ENCLUSTRA_EEPROM_MAC=y
CONFIG_SF_DEFAULT_SPEED=50000000
CONFIG_BOOT_SCRIPT_OFFSET=0x1f80000
CONFIG_ENCLUSTRA_NANDMUX=y
CONFIG_NAND=y
CONFIG_NAND_ZYNQ=y
CONFIG_CMD_NAND_LOCK_UNLOCK=y
CONFIG_SYS_MAX_NAND_DEVICE=y
CONFIG_SYS_NAND_ONFI_DETECTION=y
CONFIG_SYS_NAND_SELF_INIT=y
CONFIG_CMD_MTDPARTS=y
CONFIG_CMD_UBI=y
CONFIG_MTDIDS_DEFAULT="nand0=nand"
CONFIG_MTDPARTS_DEFAULT="mtdparts=nand:32M(nand-linux),1M(nand-bootscript),-(nand-rootfs)"
CONFIG_MTD_PARTITIONS=y
CONFIG_USE_BOOTCOMMAND=y
CONFIG_BOOTCOMMAND="run $modeboot"
CONFIG_ENCLUSTRA_QSPI_FLASHMAP=y
# CONFIG_OF_LIST is not set
# CONFIG_SPL is not set
# CONFIG_ENV_IS_IN_SPI_FLASH is not set
# CONFIG_NET_RANDOM_ETHADDR is not set
```
